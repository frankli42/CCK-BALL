## Kconfig
```kconfig
config ZMK_BEHAVIOR_ENCODER_MOUSE_SCROLL
    bool "Encoder mouse scroll behavior"
    default y
    depends on ZMK_POINTING
    help
      Scroll the mouse wheel one step per encoder detent, sent as a single
      report instead of a press and a release.
```

## dts/bindings/behaviors/zmk,behavior-encoder-mouse-scroll.yaml
```yaml
description: Encoder mouse scroll, one report per detent

compatible: "zmk,behavior-encoder-mouse-scroll"

properties:
  "#sensor-binding-cells":
    type: int
    required: true
    const: 2

sensor-binding-cells:
  - param1
  - param2
```
